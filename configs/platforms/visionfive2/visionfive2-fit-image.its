## configs/platforms/visionfive2/visionfive2-fit-image.its
```
/dts-v1/;

/ {
  description    = "U-Boot-SPL FIT Image for JH7110 VisionFive2";
  #address-cells = <2>;
  #size-cells    = <0>;

  images {
    firmware {
      description = "Caprese Microkernel";
      data        = /incbin/("caprese.bin");
      type        = "firmware";
      arch        = "riscv";
      os          = "u-boot";
      compression = "none";
      load        = <0x0 0x40000000>;
      entry       = <0x0 0x40000000>;
    };
  };

  configurations {
    default = "config-1";

    config-1 {
      description = "U-Boot-SPL FIT Config for JH7110 VisionFive2";
      firmware    = "firmware";
    };
  };
};
```
